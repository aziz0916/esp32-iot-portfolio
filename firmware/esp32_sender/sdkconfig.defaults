## firmware/esp32s3_gateway/main/Kconfig.projbuild
```kconfig
menu "Gateway Wi-Fi Configuration"

config GATEWAY_WIFI_SSID
    string "Wi-Fi SSID"
    default ""

config GATEWAY_WIFI_PASSWORD
    string "Wi-Fi password"
    default ""

config GATEWAY_MQTT_BROKER_URI
    string "MQTT broker URI"
    default ""

endmenu
```

## firmware/esp32s3_gateway/sdkconfig.defaults
```kconfig
CONFIG_IDF_TARGET="esp32s3"
CONFIG_BT_ENABLED=y
CONFIG_BT_BLE_50_FEATURES_SUPPORTED=n
CONFIG_BT_BLE_42_FEATURES_SUPPORTED=y
```
